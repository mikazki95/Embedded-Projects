/**
 * @cliArgs --device "AM64x" --package "ALV" --part "Default" --context "r5fss0-0" --product "MCU_PLUS_SDK_AM64x@09.00.00"
 * @versions {"tool":"1.17.0+3128"}
 */

/**
 * Import the modules used in this configuration.
 */
const uart       = scripting.addModule("/drivers/uart/uart", {}, false);
const uart1      = uart.addInstance();
const uart2      = uart.addInstance();
const uart3      = uart.addInstance();
const mpu_armv7  = scripting.addModule("/kernel/dpl/mpu_armv7", {}, false);
const mpu_armv71 = mpu_armv7.addInstance();
const mpu_armv72 = mpu_armv7.addInstance();
const mpu_armv73 = mpu_armv7.addInstance();
const mpu_armv74 = mpu_armv7.addInstance();
const mpu_armv75 = mpu_armv7.addInstance();
const mpu_armv76 = mpu_armv7.addInstance();

/**
 * Write custom configuration values to the imported modules.
 */
uart1.$name            = "CONFIG_UART_CONSOLE";
uart1.readCallbackFxn  = "uart_echo_read_callback";
uart1.writeCallbackFxn = "uart_echo_write_callback";
uart1.UART.$assign     = "USART0";
uart1.UART.RXD.$assign = "UART0_RXD";
uart1.UART.TXD.$assign = "UART0_TXD";

uart2.$name      = "CONFIG_UART0";
uart2.intrEnable = "USER_INTR";

uart3.$name                   = "CONFIG_UART1";
uart3.readCallbackFxn         = "uart_echo_read_callback";
uart3.writeCallbackFxn        = "uart_echo_write_callback";
uart3.readMode                = "CALLBACK";
uart3.writeMode               = "CALLBACK";
uart3.useMcuDomainPeripherals = true;
uart3.MCU_UART.$assign        = "MCU_USART1";

mpu_armv71.$name             = "CONFIG_MPU_REGION0";
mpu_armv71.size              = 31;
mpu_armv71.attributes        = "Device";
mpu_armv71.accessPermissions = "Supervisor RD+WR, User RD";
mpu_armv71.allowExecute      = false;

mpu_armv72.$name             = "CONFIG_MPU_REGION1";
mpu_armv72.size              = 15;
mpu_armv72.accessPermissions = "Supervisor RD+WR, User RD";

mpu_armv73.$name             = "CONFIG_MPU_REGION2";
mpu_armv73.baseAddr          = 0x41010000;
mpu_armv73.size              = 15;
mpu_armv73.accessPermissions = "Supervisor RD+WR, User RD";

mpu_armv74.$name             = "CONFIG_MPU_REGION3";
mpu_armv74.baseAddr          = 0x70000000;
mpu_armv74.size              = 21;
mpu_armv74.accessPermissions = "Supervisor RD+WR, User RD";

mpu_armv75.$name             = "CONFIG_MPU_REGION4";
mpu_armv75.baseAddr          = 0x60000000;
mpu_armv75.size              = 28;
mpu_armv75.accessPermissions = "Supervisor RD, User RD";

mpu_armv76.$name    = "CONFIG_MPU_REGION5";
mpu_armv76.baseAddr = 0x80000000;
mpu_armv76.size     = 31;

/**
 * Pinmux solution for unlocked pins/peripherals. This ensures that minor changes to the automatic solver in a future
 * version of the tool will not impact the pinmux you originally saw.  These lines can be completely deleted in order to
 * re-solve from scratch.
 */
uart2.UART.$suggestSolution         = "USART1";
uart2.UART.RXD.$suggestSolution     = "UART1_RXD";
uart2.UART.TXD.$suggestSolution     = "UART1_TXD";
uart3.MCU_UART.RXD.$suggestSolution = "MCU_UART1_RXD";
uart3.MCU_UART.TXD.$suggestSolution = "MCU_UART1_TXD";
